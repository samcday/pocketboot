/dts-v1/;
/plugin/;

&{/reserved-memory} {
	#address-cells = <2>;
	#size-cells = <2>;

	/* Match the fixed readback window in the pinned lk2nd 23.1 build. */
	ramoops@9ff80000 {
		compatible = "ramoops";
		reg = <0 0x9ff80000 0 0x80000>;
		record-size = <0x2000>;
		console-size = <0x40000>;
		ecc-size = <64>;
	};
};
